## Kconfig
```kconfig
menu "Easy Provision"
    choice WIFI_PROVISIONING_PORTAL
        prompt "Portal Type"
        default EASY_PROVISION_HTPORTAL
        help
            Select the type of portal to use during provisioning.
        config EASY_PROVISION_JSPORTAL
            bool "Use Javascripts"
        config EASY_PROVISION_HTPORTAL
            bool "Use HTML/CSS Only"
    endchoice
endmenu
```
